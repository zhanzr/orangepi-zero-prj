/dts-v1/;
/plugin/;

/* opz-pwm1: enable the H3 PWM controller channel 1 on PA6 (CON4.7)
 * for the ST7789 MD130 backlight. PWM0 (PA5) is left alone and uart0
 * stays enabled (unlike the stock sun8i-h3-pwm overlay). */

/ {
	compatible = "allwinner,sun8i-h3";

	fragment@0 {
		target = <&pio>;
		__overlay__ {
			pwm1_pin: pwm1-pin {
				pins = "PA6";
				function = "pwm1";
			};
		};
	};

	fragment@1 {
		target = <&pwm>;
		__overlay__ {
			pinctrl-names = "default";
			pinctrl-0 = <&pwm1_pin>;
			status = "okay";
		};
	};
};
